## conf/layer.conf
```bitbake
# We have a conf and classes directory, add to BBPATH
BBPATH .= ":${LAYERDIR}"

# We have recipes-* directories, add to BBFILES
BBFILES += " \
    ${LAYERDIR}/recipes-*/*/*.bb \
    ${LAYERDIR}/recipes-*/*/*.bbappend \
    "

BBFILE_COLLECTIONS += "test"
BBFILE_PRIORITY_test = "5"
BBFILE_PATTERN_test = "^${LAYERDIR}/"
BBFILE_PATTERN_IGNORE_EMPTY_test = "1"

LAYERDEPENDS_test = "\
    core \
    "

LAYERSERIES_COMPAT_test = "scarthgap"

LAYERBASE_test = "${LAYERDIR}"
```
